#include <dt-bindings/zmk/matrix_transform.h>
/ {
chosen {
zmk,kscan = &kscan0;
};
kscan0: kscan {
compatible = "zmk,kscan-gpio-matrix";
diode-direction = "col2row";
row-gpios =
<&gpio1 4 GPIO_ACTIVE_HIGH>
<&gpio1 5 GPIO_ACTIVE_HIGH>
<&gpio1 6 GPIO_ACTIVE_HIGH>
<&gpio1 7 GPIO_ACTIVE_HIGH>
<&gpio1 8 GPIO_ACTIVE_HIGH>
<&gpio1 10 GPIO_ACTIVE_HIGH>;
col-gpios =
<&gpio0 8 GPIO_ACTIVE_HIGH>
<&gpio0 14 GPIO_ACTIVE_HIGH>
<&gpio0 16 GPIO_ACTIVE_HIGH>
<&gpio0 17 GPIO_ACTIVE_HIGH>
<&gpio0 20 GPIO_ACTIVE_HIGH>
<&gpio0 21 GPIO_ACTIVE_HIGH>
<&gpio0 22 GPIO_ACTIVE_HIGH>
<&gpio0 24 GPIO_ACTIVE_HIGH>
<&gpio0 25 GPIO_ACTIVE_HIGH>
<&gpio0 27 GPIO_ACTIVE_HIGH>
<&gpio0 28 GPIO_ACTIVE_HIGH>
<&gpio0 29 GPIO_ACTIVE_HIGH>
<&gpio0 30 GPIO_ACTIVE_HIGH>
<&gpio0 31 GPIO_ACTIVE_HIGH>
<&gpio1 1 GPIO_ACTIVE_HIGH>
<&gpio1 2 GPIO_ACTIVE_HIGH>
<&gpio1 3 GPIO_ACTIVE_HIGH>;
};
encoder_left: encoder_left {
compatible = "alps,ec11";
a-gpios = <&gpio0 4 GPIO_ACTIVE_HIGH>;
b-gpios = <&gpio0 5 GPIO_ACTIVE_HIGH>;
steps = <30>;
status = "okay";
};
};
